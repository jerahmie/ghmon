## main/Kconfig.projbuild
```kconfig
menu "GHMON Peripherals Config"

    menu "I2C Master"
        config I2C_MASTER_SCL
            int "SCL GPIO Num"
            default 19
            help
                GPIO number for I2C Master clock line.
        config I2C_MASTER_SDA
            int "SDA GPIO Num"
            default 18
            help    
                GPIO number for I2C Master data line.

        config I2C_MASTER_PORT_NUM
            int "Port Number"
            default 1
            help
                Port number for I2C Master device.

        config I2C_MASTER_FREQUENCY
            int "Master Frequency"
            default 100000
            help 
                I2C Speed of Master device.
    endmenu

    menu "I2C Slave"
        config I2C_SLAVE_SCL
            int "SCL GPIO Num"
            default 5
            help
                GPIO number for I2C Slave clock line.

        config I2C_SLAVE_SDA
            int "SDA GPIO Num"
            default 4
            help
                GPIO number for I2C Slave data line.
        
        config I2C_SLAVE_PORT_NUM
            int "Port Number"
            default 0
            help
                Port number for I2C Slave device.

        config I2C_SLAVE_ADDRESS
            hex "ESP Slave Address"
            default 0x28
            help
                Hardware Address of I2C Slave Port.
    endmenu

    menu "I2C OLED Display (SSD1306)"
        choice SSD1306_ADDR
            prompt "SSD1306 I2C Address"
            default SSD1306_ADDRESS_LOW
            help
                Hardware address of SSD1306 OLED display

            config SSD1306_ADDRESS_LOW
                bool "SSD1306 I2C Address(ADDR=0)"
                help
                    I2C Address of SSD1306 OLED Display according to hardware schematic.
            
            config SSD1306_ADDRESS_HIGH
                bool "SSD1306 I2C Address(ADDR=1)"
                help
                    I2C Address of SSD1306 OLED Display according to hardware schematic.
        endchoice                

    config SSD1306_ADDR
        hex
        default 0x3C if SSD1306_ADDRESS_LOW
        default 0x3D if SSD1306_ADDRESS_HIGH
    
    endmenu

    menu "CCS811 Gas Monitor"
        choice CCS811_ADDR
            prompt "CCS811 I2C Address"
            default CCS811_I2C_ADDRESS_LOW
            help
                Hardware address of CCS811 determined by ADDR pin.
        
            config CCS811_I2C_ADDRESS_LOW
                bool "CCS811 I2C Address(ADDR=0)"
                help
                    I2C Address of CCS811 sensor according to schematic configuration.
            
            config CCS811_I2C_ADDRESS_HIGH
                bool "CCS811 I2C Address(ADDR=1)"
                help
                    I2C Address of CCS811 sensor according to schematic configuration.
        endchoice

    config CCS811_ADDR
        hex
        default 0x5A if CCS811_I2C_ADDRESS_LOW
        default 0x5B if CCS811_I2C_ADDRESS_HIGH


    endmenu

endmenu
```
